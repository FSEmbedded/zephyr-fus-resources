## boards/picocoremx93/board.yml
```yaml
board:
  name: picocoremx93
  full_name: PicoCoreMX93
  vendor: F+S
  socs:
  - name: mimx9352
    variants:
    - name: ddr
      cpucluster: m33
```

## west.yml
```yaml
manifest:
  projects:
    - name: zephyr-fus
      url: https://github.com/FSEmbedded/zephyr-fus
      revision: main
      path: zephyr
    - name: zephyr-fus-resources
      url: https://github.com/FSEmbedded/zephyr-fus-resources
      revision: main
      path: modules/zephyr-fus-resources
  self:
    path: .
```
